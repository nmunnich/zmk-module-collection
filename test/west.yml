## test/west.yml
```yaml
manifest:
  projects:
    - name: zmk-module-collection
      url: git@github.com:Nick-Munnich/zmk-module-collection.git
      revision: main
      import:
         name-allowlist: 
             - zmk-keyboards-akohekohe
```

## west.yml
```yaml
manifest:
  defaults:
    revision: v0.2
  remotes:
    - name: zmkfirmware
      url-base: https://github.com/zmkfirmware
  group-filter: [-placeholder]
  projects:
    - name: zmk
      remote: zmkfirmware
      import: app/west.yml
    - name: zmk-module-placeholder
      url: git@github.com:nmunnich/zmk-module-template.git
      revision: main
      groups: [placeholder]
  self:
    import:
      - behaviors
      - components
      - drivers
      - features
      - keyboards
      - vfx
```
